/*
 * Copyright (c) 2024 The ZMK Contributors
 *
 * SPDX-License-Identifier: MIT
 *
 * DM45 right-hand peripheral — nice!nano v2 (Pro Micro footprint).
 *
 * Matrix wiring (mirrored — cols reversed vs left, rows same order):
 *   Row 0 … Row 4  →  D9, D8, D7, D6, D5
 *   Col 0 … Col 4  →  D10, D16, D14, D15, A3(D18)
 *
 * col-offset = <5> maps local cols 0-4 to logical keymap cols 5-9.
 */

#include "dm45.dtsi"

&default_transform {
    col-offset = <5>;
};

&kscan0 {
    compatible = "zmk,kscan-gpio-matrix";

    row-gpios
        = <&pro_micro  9 (GPIO_ACTIVE_HIGH | GPIO_PULL_DOWN)>
        , <&pro_micro  8 (GPIO_ACTIVE_HIGH | GPIO_PULL_DOWN)>
        , <&pro_micro  7 (GPIO_ACTIVE_HIGH | GPIO_PULL_DOWN)>
        , <&pro_micro  6 (GPIO_ACTIVE_HIGH | GPIO_PULL_DOWN)>
        , <&pro_micro  5 (GPIO_ACTIVE_HIGH | GPIO_PULL_DOWN)>
        ;

    col-gpios
        = <&pro_micro 10 GPIO_ACTIVE_HIGH>
        , <&pro_micro 16 GPIO_ACTIVE_HIGH>
        , <&pro_micro 14 GPIO_ACTIVE_HIGH>
        , <&pro_micro 15 GPIO_ACTIVE_HIGH>
        , <&pro_micro 18 GPIO_ACTIVE_HIGH>
        ;
};
