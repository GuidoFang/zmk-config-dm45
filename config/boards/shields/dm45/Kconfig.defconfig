## config/boards/shields/dm45/Kconfig.defconfig
```kconfig
# Copyright (c) 2024 The ZMK Contributors
# SPDX-License-Identifier: MIT

if SHIELD_DM45_DONGLE

config ZMK_KEYBOARD_NAME
	default "DM45"

config ZMK_SPLIT_ROLE_CENTRAL
	default y

config ZMK_USB
	default y

endif  # SHIELD_DM45_DONGLE

if SHIELD_DM45_LEFT || SHIELD_DM45_RIGHT || SHIELD_DM45_DONGLE

config ZMK_SPLIT
	default y

config ZMK_BLE
	default y

endif  # SHIELD_DM45_LEFT || SHIELD_DM45_RIGHT || SHIELD_DM45_DONGLE
```

## config/boards/shields/dm45/Kconfig.shield
```kconfig
# Copyright (c) 2024 The ZMK Contributors
# SPDX-License-Identifier: MIT

config SHIELD_DM45_LEFT
	def_bool $(shields_list_contains,dm45_left)

config SHIELD_DM45_RIGHT
	def_bool $(shields_list_contains,dm45_right)

config SHIELD_DM45_DONGLE
	def_bool $(shields_list_contains,dm45_dongle)
```
